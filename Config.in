## Config.in
```kconfig
config BR2_DEVICE
    string
    option env="DEVICE"

config BR2_PACKAGE_RLXOS
    bool "rlxos"
	depends on BR2_TOOLCHAIN_HAS_THREADS
    help
        Install RLXOS Components
```

## board/x86_64-bios/defconfig
```kconfig
BR2_x86_64=y
BR2_TOOLCHAIN_BUILDROOT_VENDOR="rlxnix"
BR2_TOOLCHAIN_BUILDROOT_MUSL=y
BR2_BINUTILS_VERSION_2_41_X=y
BR2_GCC_VERSION_13_X=y
BR2_TOOLCHAIN_BUILDROOT_CXX=y
BR2_GCC_ENABLE_GRAPHITE=y
BR2_PACKAGE_HOST_GDB=y
BR2_CCACHE=y
BR2_ENABLE_LTO=y
BR2_FORCE_HOST_BUILD=y
BR2_TARGET_GENERIC_HOSTNAME="localhost"
BR2_TARGET_GENERIC_ISSUE="rlxnix"
BR2_TARGET_GENERIC_PASSWD_SHA512=y
BR2_ROOTFS_DEVICE_CREATION_DYNAMIC_EUDEV=y
BR2_ROOTFS_DEVICE_TABLE_SUPPORTS_EXTENDED_ATTRIBUTES=y
BR2_ROOTFS_MERGED_USR=y
BR2_TARGET_GENERIC_ROOT_PASSWD="root"
BR2_TARGET_TZ_INFO=y
BR2_ROOTFS_POST_BUILD_SCRIPT="$(BR2_EXTERNAL_RLXOS_PATH)/board/$(BOARD_NAME)/post-build.sh"
BR2_ROOTFS_POST_IMAGE_SCRIPT="support/scripts/genimage.sh"
BR2_ROOTFS_POST_SCRIPT_ARGS="-c $(BR2_EXTERNAL_RLXOS_PATH)/board/$(BOARD_NAME)/genimage.cfg"
BR2_LINUX_KERNEL=y
BR2_LINUX_KERNEL_USE_CUSTOM_CONFIG=y
BR2_LINUX_KERNEL_CUSTOM_CONFIG_FILE="$(BR2_EXTERNAL_RLXOS_PATH)/board/$(BOARD_NAME)/linux.conf"
BR2_LINUX_KERNEL_ZSTD=y
BR2_LINUX_KERNEL_INSTALL_TARGET=y
BR2_LINUX_KERNEL_NEEDS_HOST_OPENSSL=y
BR2_LINUX_KERNEL_NEEDS_HOST_LIBELF=y
BR2_PACKAGE_BUSYBOX_CONFIG="$(BR2_EXTERNAL_RLXOS_PATH)/busybox.conf"
BR2_PACKAGE_BUSYBOX_SHOW_OTHERS=y
BR2_PACKAGE_BUSYBOX_WATCHDOG=y
BR2_PACKAGE_COMIX_CURSORS=y
BR2_PACKAGE_LIBERATION=y
BR2_PACKAGE_HICOLOR_ICON_THEME=y
BR2_PACKAGE_SOUND_THEME_FREEDESKTOP=y
BR2_PACKAGE_COG=y
# BR2_PACKAGE_COG_PLATFORM_FDO is not set
BR2_PACKAGE_COG_PLATFORM_DRM=y
BR2_PACKAGE_COG_USE_SYSTEM_DBUS=y
BR2_PACKAGE_MESA3D=y
BR2_PACKAGE_MESA3D_GALLIUM_DRIVER_CROCUS=y
BR2_PACKAGE_MESA3D_GALLIUM_DRIVER_I915=y
BR2_PACKAGE_MESA3D_GALLIUM_DRIVER_IRIS=y
BR2_PACKAGE_MESA3D_GALLIUM_DRIVER_LIMA=y
BR2_PACKAGE_MESA3D_GALLIUM_DRIVER_NOUVEAU=y
BR2_PACKAGE_MESA3D_GALLIUM_DRIVER_R300=y
BR2_PACKAGE_MESA3D_GALLIUM_DRIVER_R600=y
BR2_PACKAGE_MESA3D_GALLIUM_DRIVER_SVGA=y
BR2_PACKAGE_MESA3D_GALLIUM_DRIVER_VIRGL=y
BR2_PACKAGE_MESA3D_OSMESA_GALLIUM=y
BR2_PACKAGE_MESA3D_OPENGL_ES=y
BR2_PACKAGE_VULKAN_TOOLS=y
BR2_PACKAGE_EUDEV_RULES_GEN=y
BR2_PACKAGE_HWDATA=y
BR2_PACKAGE_KBD=y
BR2_PACKAGE_WPEWEBKIT=y
BR2_TARGET_ROOTFS_EXT2=y
BR2_TARGET_ROOTFS_EXT2_4=y
BR2_TARGET_ROOTFS_EXT2_LABEL="rlxnix"
BR2_TARGET_ROOTFS_EXT2_SIZE="500M"
BR2_TARGET_ROOTFS_EXT2_ZSTD=y
# BR2_TARGET_ROOTFS_TAR is not set
BR2_TARGET_GRUB2=y
BR2_TARGET_GRUB2_INSTALL_TOOLS=y
BR2_PACKAGE_HOST_GENIMAGE=y
```

## board/x86_64/defconfig
```kconfig
BR2_x86_64=y
BR2_TOOLCHAIN_BUILDROOT_VENDOR="rlxos"
BR2_TOOLCHAIN_BUILDROOT_MUSL=y
BR2_KERNEL_HEADERS_6_6=y
BR2_TOOLCHAIN_BUILDROOT_CXX=y
BR2_GCC_ENABLE_GRAPHITE=y
BR2_PACKAGE_HOST_GDB=y
BR2_ENABLE_LTO=y
BR2_FORCE_HOST_BUILD=y
BR2_TARGET_GENERIC_HOSTNAME="workstation"
BR2_TARGET_GENERIC_ISSUE="RLXOS"
BR2_ROOTFS_DEVICE_CREATION_DYNAMIC_MDEV=y
BR2_ROOTFS_DEVICE_TABLE_SUPPORTS_EXTENDED_ATTRIBUTES=y
BR2_ROOTFS_MERGED_USR=y
BR2_TARGET_GENERIC_ROOT_PASSWD="root"
BR2_TARGET_TZ_INFO=y
BR2_LINUX_KERNEL=y
BR2_LINUX_KERNEL_USE_ARCH_DEFAULT_CONFIG=y
BR2_LINUX_KERNEL_CONFIG_FRAGMENT_FILES="$(BR2_EXTERNAL_RLXOS_PATH)/board/$(BOARD_NAME)/linux.conf"
BR2_PACKAGE_BUSYBOX_CONFIG_FRAGMENT_FILES="$(BR2_EXTERNAL_RLXOS_PATH)/board/$(BOARD_NAME)/busybox.conf"
BR2_PACKAGE_BUSYBOX_SHOW_OTHERS=y
BR2_PACKAGE_BUSYBOX_WATCHDOG=y
BR2_TARGET_ROOTFS_CPIO_DRACUT=y
BR2_TARGET_ROOTFS_CPIO_ZSTD=y
BR2_TARGET_ROOTFS_INITRAMFS=y
BR2_TARGET_ROOTFS_ISO9660=y
BR2_TARGET_ROOTFS_ISO9660_HYBRID=y
# BR2_TARGET_ROOTFS_TAR is not set
BR2_TARGET_SYSLINUX=y
```

## build/buildroot/x86_64_defconfig
```kconfig
BR2_x86_64=y
BR2_TOOLCHAIN_EXTERNAL=y
BR2_TOOLCHAIN_EXTERNAL_CUSTOM=y
BR2_TOOLCHAIN_EXTERNAL_PATH="$(TOOLCHAIN_PATH)"
BR2_TOOLCHAIN_EXTERNAL_CUSTOM_PREFIX="$(ARCH)-linux-musl"
BR2_TOOLCHAIN_EXTERNAL_CUSTOM_MUSL=y
BR2_TOOLCHAIN_EXTERNAL_HAS_SSP=y
BR2_TOOLCHAIN_EXTERNAL_HAS_SSP_STRONG=y
BR2_TOOLCHAIN_EXTERNAL_GCC_15=y
BR2_TOOLCHAIN_EXTERNAL_HEADERS_6_16=y
BR2_TOOLCHAIN_EXTERNAL_CXX=y
BR2_TOOLCHAIN_EXTERNAL_FORTRAN=y
BR2_TOOLCHAIN_EXTERNAL_OPENMP=y
BR2_ENABLE_LTO=y
BR2_SHARED_LIBS=y
BR2_TARGET_GENERIC_PASSWD_SHA512=y
BR2_INIT_NONE=y
BR2_ROOTFS_DEVICE_CREATION_DYNAMIC_EUDEV=y
BR2_ROOTFS_DEVICE_TABLE_SUPPORTS_EXTENDED_ATTRIBUTES=y
BR2_ROOTFS_MERGED_USR=y
BR2_SYSTEM_BIN_SH_NONE=y
BR2_TARGET_TZ_INFO=y
BR2_PACKAGE_BUSYBOX=n
BR2_PACKAGE_SQUASHFS=y
BR2_PACKAGE_CA_CERTIFICATES=y
BR2_PACKAGE_SEATD_DAEMON=y
BR2_PACKAGE_FCFT=y
BR2_PACKAGE_LIBGLVND=y
BR2_PACKAGE_MESA3D=y
BR2_PACKAGE_MESA3D_GALLIUM_DRIVER_IRIS=y
BR2_PACKAGE_MESA3D_GALLIUM_DRIVER_I915=y
BR2_PACKAGE_MESA3D_GALLIUM_DRIVER_VIRGL=y
BR2_PACKAGE_MESA3D_GALLIUM_DRIVER_SVGA=y
BR2_PACKAGE_MESA3D_OPENGL_ES=y
BR2_PACKAGE_XKEYBOARD_CONFIG=y
BR2_PACKAGE_WLROOTS=y
BR2_PACKAGE_FOOT=y
BR2_PACKAGE_VULKAN_HEADERS=y
# BR2_TARGET_ROOTFS_TAR is not set
BR2_TARGET_GRUB2=y
BR2_TARGET_GRUB2_I386_PC=y
BR2_TARGET_GRUB2_X86_64_EFI=y
BR2_TARGET_GRUB2_INSTALL_TOOLS=y
BR2_TARGET_SYSLINUX=y
```

## defconfig
```kconfig
BR2_TOOLCHAIN_BUILDROOT_VENDOR="rlxos"
BR2_TOOLCHAIN_BUILDROOT_MUSL=y
BR2_BINUTILS_VERSION_2_41_X=y
BR2_GCC_VERSION_13_X=y
BR2_TOOLCHAIN_BUILDROOT_CXX=y
BR2_GCC_ENABLE_GRAPHITE=y
BR2_PACKAGE_HOST_GDB=y
BR2_GDB_VERSION_14=y
BR2_CCACHE=y
BR2_ENABLE_LTO=y
BR2_FORCE_HOST_BUILD=y
BR2_TARGET_GENERIC_HOSTNAME="rlxos"
BR2_TARGET_GENERIC_ISSUE="Welcome to rlxos"
BR2_TARGET_GENERIC_PASSWD_SHA512=y
BR2_ROOTFS_DEVICE_CREATION_DYNAMIC_EUDEV=y
BR2_ROOTFS_DEVICE_TABLE_SUPPORTS_EXTENDED_ATTRIBUTES=y
BR2_ROOTFS_MERGED_USR=y
BR2_TARGET_GENERIC_ROOT_PASSWD="root"
BR2_SYSTEM_DEFAULT_PATH="/bin:/sbin:/usr/bin:/usr/sbin"
BR2_SYSTEM_ENABLE_NLS=y
BR2_TARGET_TZ_INFO=y
BR2_ROOTFS_USERS_TABLES="$(BR2_EXTERNAL_RLXOS_PATH)/users.conf"
BR2_ROOTFS_OVERLAY="$(BR2_EXTERNAL_RLXOS_PATH)/overlay $(BR2_EXTERNAL_RLXOS_PATH)/board/$(BOARD_NAME)/overlay"
BR2_ROOTFS_POST_BUILD_SCRIPT="$(BR2_EXTERNAL_RLXOS_PATH)/board/$(BOARD_NAME)/post-build.sh"
BR2_ROOTFS_POST_IMAGE_SCRIPT="$(BR2_EXTERNAL_RLXOS_PATH)/board/$(BOARD_NAME)/post-image.sh"
BR2_LINUX_KERNEL=y
BR2_LINUX_KERNEL_USE_CUSTOM_CONFIG=y
BR2_LINUX_KERNEL_CUSTOM_CONFIG_FILE="$(BR2_EXTERNAL_RLXOS_PATH)/board/$(BOARD_NAME)/linux.conf"
BR2_LINUX_KERNEL_INSTALL_TARGET=y
BR2_LINUX_KERNEL_NEEDS_HOST_LIBELF=y
BR2_PACKAGE_BUSYBOX_CONFIG="$(BR2_EXTERNAL_RLXOS_PATH)/busybox.conf"
BR2_PACKAGE_BUSYBOX_SHOW_OTHERS=y
BR2_PACKAGE_BUSYBOX_WATCHDOG=y
BR2_PACKAGE_ZSTD=y
BR2_PACKAGE_COMIX_CURSORS=y
BR2_PACKAGE_INCONSOLATA=y
BR2_PACKAGE_LIBERATION=y
BR2_PACKAGE_HICOLOR_ICON_THEME=y
BR2_PACKAGE_SOUND_THEME_FREEDESKTOP=y
BR2_PACKAGE_FOOT=y
BR2_PACKAGE_FOOT_GRAPHEME_CLUSTERING=y
BR2_PACKAGE_FOOT_THEMES=y
BR2_PACKAGE_SWAY=y
BR2_PACKAGE_SWAY_SWAYBAR=y
BR2_PACKAGE_SWAY_SWAYNAG=y
BR2_PACKAGE_MESA3D=y
BR2_PACKAGE_MESA3D_GALLIUM_DRIVER_CROCUS=y
BR2_PACKAGE_MESA3D_GALLIUM_DRIVER_I915=y
BR2_PACKAGE_MESA3D_GALLIUM_DRIVER_IRIS=y
BR2_PACKAGE_MESA3D_GALLIUM_DRIVER_NOUVEAU=y
BR2_PACKAGE_MESA3D_GALLIUM_DRIVER_R300=y
BR2_PACKAGE_MESA3D_GALLIUM_DRIVER_R600=y
BR2_PACKAGE_MESA3D_GALLIUM_DRIVER_SVGA=y
BR2_PACKAGE_MESA3D_GALLIUM_DRIVER_VIRGL=y
BR2_PACKAGE_MESA3D_OSMESA_GALLIUM=y
BR2_PACKAGE_MESA3D_OPENGL_ES=y
BR2_PACKAGE_PSPLASH=y
BR2_PACKAGE_PSPLASH_IMAGE="$(BR2_EXTERNAL_RLXOS_PATH)/assets/branding/rlxos-psplash.png"
BR2_PACKAGE_EUDEV_RULES_GEN=y
BR2_PACKAGE_LIBGLFW=y
BR2_PACKAGE_KMOD_TOOLS=y
BR2_PACKAGE_SEATD_BUILTIN=y
BR2_PACKAGE_SEATD_DAEMON=y
```

## device/raspberrypi-0w/defconfig
```kconfig
BR2_arm=y
BR2_arm1176jzf_s=y
BR2_TOOLCHAIN_BUILDROOT_VENDOR="rlxos"
BR2_TOOLCHAIN_BUILDROOT_MUSL=y
BR2_PACKAGE_HOST_LINUX_HEADERS_CUSTOM_6_1=y
BR2_TOOLCHAIN_BUILDROOT_CXX=y
BR2_GCC_ENABLE_GRAPHITE=y
BR2_PACKAGE_HOST_GDB=y
BR2_CCACHE=y
BR2_ENABLE_LTO=y
BR2_GLOBAL_PATCH_DIR="$(BR2_EXTERNAL_RLXOS_PATH)/patch $(BR2_EXTERNAL_RLXOS_PATH)/board/$(BOARD_NAME)/patch $(BR2_EXTERNAL_RLXOS_PATH)/board/raspberrypi-common/patch"
BR2_FORCE_HOST_BUILD=y
BR2_DOWNLOAD_FORCE_CHECK_HASHES=y
BR2_TARGET_GENERIC_HOSTNAME="rlxos"
BR2_TARGET_GENERIC_ISSUE="Welcome to rlxos"
BR2_TARGET_GENERIC_PASSWD_SHA512=y
BR2_INIT_NONE=y
BR2_ROOTFS_DEVICE_CREATION_DYNAMIC_EUDEV=y
BR2_ROOTFS_DEVICE_TABLE_SUPPORTS_EXTENDED_ATTRIBUTES=y
BR2_ROOTFS_MERGED_USR=y
BR2_TARGET_GENERIC_ROOT_PASSWD="root"
BR2_SYSTEM_ENABLE_NLS=y
BR2_TARGET_TZ_INFO=y
BR2_ROOTFS_USERS_TABLES="$(BR2_EXTERNAL_RLXOS_PATH)/config/users.conf"
BR2_ROOTFS_OVERLAY="$(BR2_EXTERNAL_RLXOS_PATH)/overlay $(BR2_EXTERNAL_RLXOS_PATH)/board/$(BOARD_NAME)/overlay"
BR2_ROOTFS_POST_BUILD_SCRIPT="$(BR2_EXTERNAL_RLXOS_PATH)/board/raspberrypi-common/post-build.sh"
BR2_ROOTFS_POST_IMAGE_SCRIPT="$(BR2_EXTERNAL_RLXOS_PATH)/board/raspberrypi-common/post-image.sh"
BR2_LINUX_KERNEL=y
BR2_LINUX_KERNEL_CUSTOM_TARBALL=y
BR2_LINUX_KERNEL_CUSTOM_TARBALL_LOCATION="$(call github,raspberrypi,linux,17f135b742c4edb340afb365873c3a574f7e16cb)/linux-17f135b742c4edb340afb365873c3a574f7e16cb.tar.gz"
BR2_LINUX_KERNEL_DEFCONFIG="bcmrpi"
BR2_LINUX_KERNEL_CONFIG_FRAGMENT_FILES="$(BR2_EXTERNAL_RLXOS_PATH)/board/$(BOARD_NAME)/linux.config"
BR2_LINUX_KERNEL_DTS_SUPPORT=y
BR2_LINUX_KERNEL_INTREE_DTS_NAME="bcm2708-rpi-zero-w"
BR2_LINUX_KERNEL_NEEDS_HOST_LIBELF=y
BR2_PACKAGE_BUSYBOX_CONFIG="$(BR2_EXTERNAL_RLXOS_PATH)/config/busybox.conf"
BR2_PACKAGE_BUSYBOX_SHOW_OTHERS=y
BR2_PACKAGE_BUSYBOX_WATCHDOG=y
BR2_PACKAGE_ALSA_UTILS=y
BR2_PACKAGE_ALSA_UTILS_AMIXER=y
BR2_PACKAGE_ALSA_UTILS_APLAY=y
BR2_PACKAGE_FLITE=y
BR2_PACKAGE_GSTREAMER1=y
BR2_PACKAGE_GST1_PLUGINS_BASE=y
BR2_PACKAGE_TINYCOMPRESS=y
BR2_PACKAGE_DOSFSTOOLS=y
BR2_PACKAGE_DOSFSTOOLS_FATLABEL=y
BR2_PACKAGE_DOSFSTOOLS_FSCK_FAT=y
BR2_PACKAGE_DOSFSTOOLS_MKFS_FAT=y
BR2_PACKAGE_E2FSPROGS=y
BR2_PACKAGE_E2FSPROGS_RESIZE2FS=y
BR2_PACKAGE_NTFS_3G=y
BR2_PACKAGE_NTFS_3G_ENCRYPTED=y
BR2_PACKAGE_NTFS_3G_NTFSPROGS=y
BR2_PACKAGE_SQUASHFS=y
BR2_PACKAGE_INCONSOLATA=y
BR2_PACKAGE_LIBERATION=y
BR2_PACKAGE_HICOLOR_ICON_THEME=y
BR2_PACKAGE_FOOT=y
BR2_PACKAGE_FOOT_GRAPHEME_CLUSTERING=y
BR2_PACKAGE_SWAY=y
BR2_PACKAGE_SWAY_SWAYBAR=y
BR2_PACKAGE_SWAY_SWAYBAR_TRAY=y
BR2_PACKAGE_SWAY_SWAYNAG=y
BR2_PACKAGE_MESA3D=y
BR2_PACKAGE_MESA3D_GALLIUM_DRIVER_NOUVEAU=y
BR2_PACKAGE_MESA3D_GALLIUM_DRIVER_V3D=y
BR2_PACKAGE_MESA3D_GALLIUM_DRIVER_VIRGL=y
BR2_PACKAGE_MESA3D_OSMESA_GALLIUM=y
BR2_PACKAGE_MESA3D_OPENGL_ES=y
BR2_PACKAGE_PSPLASH=y
BR2_PACKAGE_PSPLASH_IMAGE="$(BR2_EXTERNAL_RLXOS_PATH)/assets/branding/rlxos-psplash.png"
BR2_PACKAGE_XORG7=y
BR2_PACKAGE_RPI_FIRMWARE=y
BR2_PACKAGE_RPI_FIRMWARE_BOOTCODE_BIN=y
BR2_PACKAGE_RPI_FIRMWARE_VARIANT_PI=y
BR2_PACKAGE_RPI_FIRMWARE_CONFIG_FILE="$(BR2_EXTERNAL_RLXOS_PATH)/board/$(BOARD_NAME)/config.txt"
BR2_PACKAGE_EUDEV_RULES_GEN=y
BR2_PACKAGE_UPOWER=y
BR2_PACKAGE_ALSA_PLUGINS=y
BR2_PACKAGE_LIBSNDFILE=y
BR2_PACKAGE_CA_CERTIFICATES=y
BR2_PACKAGE_OPENSSL=y
BR2_PACKAGE_LIBRESSL=y
BR2_PACKAGE_LIBRESSL_BIN=y
BR2_PACKAGE_CAIRO_PS=y
BR2_PACKAGE_CAIRO_SCRIPT=y
BR2_PACKAGE_CAIRO_SVG=y
BR2_PACKAGE_GIFLIB=y
BR2_PACKAGE_JPEG=y
BR2_PACKAGE_LIBGLFW=y
BR2_PACKAGE_WLROOTS_XWAYLAND=y
BR2_PACKAGE_LIBSEMANAGE=y
BR2_PACKAGE_PCRE2_JIT=y
BR2_PACKAGE_DROPBEAR=y
BR2_PACKAGE_DROPBEAR_WTMP=y
BR2_PACKAGE_DROPBEAR_LASTLOG=y
BR2_PACKAGE_IWD=y
BR2_PACKAGE_LINKS=y
BR2_PACKAGE_URANDOM_SCRIPTS=y
BR2_PACKAGE_DIALOG=y
BR2_PACKAGE_KMOD_TOOLS=y
BR2_PACKAGE_SEATD_BUILTIN=y
BR2_PACKAGE_SEATD_DAEMON=y
BR2_TARGET_ROOTFS_EXT2=y
BR2_TARGET_ROOTFS_EXT2_4=y
BR2_TARGET_ROOTFS_EXT2_SIZE="256M"
# BR2_TARGET_ROOTFS_TAR is not set
BR2_PACKAGE_HOST_DOSFSTOOLS=y
BR2_PACKAGE_HOST_GENIMAGE=y
BR2_PACKAGE_HOST_KMOD_GZ=y
BR2_PACKAGE_HOST_KMOD_ZSTD=y
BR2_PACKAGE_HOST_KMOD_XZ=y
BR2_PACKAGE_HOST_MTOOLS=y
BR2_PACKAGE_RLXOS=y
BR2_PACKAGE_SWAYLOCK=y
BR2_PACKAGE_I3BLOCKS=y
BR2_PACKAGE_MAKO=y
```

## device/x86_64/defconfig
```kconfig
BR2_x86_64=y
BR2_TOOLCHAIN_BUILDROOT_VENDOR="rlxos"
BR2_TOOLCHAIN_BUILDROOT_MUSL=y
BR2_BINUTILS_VERSION_2_42_X=y
BR2_GCC_VERSION_14_X=y
BR2_TOOLCHAIN_BUILDROOT_CXX=y
BR2_GCC_ENABLE_GRAPHITE=y
BR2_PACKAGE_HOST_GDB=y
BR2_GDB_VERSION_14=y
BR2_CCACHE=y
BR2_ENABLE_DEBUG=y
BR2_ENABLE_LTO=y
BR2_GLOBAL_PATCH_DIR="$(BR2_EXTERNAL_RLXOS_PATH)/patch $(BR2_EXTERNAL_RLXOS_PATH)/device/$(DEVICE)/patch"
BR2_FORCE_HOST_BUILD=y
BR2_TARGET_GENERIC_HOSTNAME="rlxos"
BR2_TARGET_GENERIC_ISSUE="Welcome to rlxos"
BR2_TARGET_GENERIC_PASSWD_SHA512=y
BR2_INIT_NONE=y
BR2_ROOTFS_DEVICE_CREATION_DYNAMIC_EUDEV=y
BR2_ROOTFS_DEVICE_TABLE_SUPPORTS_EXTENDED_ATTRIBUTES=y
BR2_ROOTFS_MERGED_USR=y
BR2_TARGET_GENERIC_ROOT_PASSWD="rlxos"
BR2_SYSTEM_ENABLE_NLS=y
BR2_TARGET_TZ_INFO=y
BR2_ROOTFS_USERS_TABLES="$(BR2_EXTERNAL_RLXOS_PATH)/config/users.conf"
BR2_ROOTFS_POST_BUILD_SCRIPT="$(BR2_EXTERNAL_RLXOS_PATH)/device/$(DEVICE)/post-build.sh"
BR2_ROOTFS_POST_IMAGE_SCRIPT="$(BR2_EXTERNAL_RLXOS_PATH)/device/$(DEVICE)/post-image.sh"
BR2_LINUX_KERNEL=y
BR2_LINUX_KERNEL_USE_CUSTOM_CONFIG=y
BR2_LINUX_KERNEL_CUSTOM_CONFIG_FILE="$(BR2_EXTERNAL_RLXOS_PATH)/device/$(DEVICE)/linux.conf"
BR2_LINUX_KERNEL_INSTALL_TARGET=y
BR2_LINUX_KERNEL_NEEDS_HOST_LIBELF=y
BR2_PACKAGE_BUSYBOX_CONFIG="$(BR2_EXTERNAL_RLXOS_PATH)/config/busybox.conf"
BR2_PACKAGE_BUSYBOX_SHOW_OTHERS=y
BR2_PACKAGE_BUSYBOX_WATCHDOG=y
BR2_PACKAGE_FOOT=y
BR2_PACKAGE_FOOT_GRAPHEME_CLUSTERING=y
BR2_PACKAGE_SWAY=y
BR2_PACKAGE_SWAY_SWAYBAR=y
BR2_PACKAGE_SWAY_SWAYBAR_TRAY=y
BR2_PACKAGE_SWAY_SWAYNAG=y
BR2_PACKAGE_MESA3D=y
BR2_PACKAGE_MESA3D_GALLIUM_DRIVER_CROCUS=y
BR2_PACKAGE_MESA3D_GALLIUM_DRIVER_I915=y
BR2_PACKAGE_MESA3D_GALLIUM_DRIVER_IRIS=y
BR2_PACKAGE_MESA3D_GALLIUM_DRIVER_NOUVEAU=y
BR2_PACKAGE_MESA3D_GALLIUM_DRIVER_R300=y
BR2_PACKAGE_MESA3D_GALLIUM_DRIVER_R600=y
BR2_PACKAGE_MESA3D_GALLIUM_DRIVER_SVGA=y
BR2_PACKAGE_MESA3D_GALLIUM_DRIVER_VIRGL=y
BR2_PACKAGE_MESA3D_OSMESA_GALLIUM=y
BR2_PACKAGE_MESA3D_OPENGL_ES=y
BR2_PACKAGE_VULKAN_LOADER=y
BR2_PACKAGE_XORG7=y
BR2_PACKAGE_LINUX_FIRMWARE=y
BR2_PACKAGE_LINUX_FIRMWARE_INTEL_SST_DSP=y
BR2_PACKAGE_LINUX_FIRMWARE_AMDGPU=y
BR2_PACKAGE_LINUX_FIRMWARE_I915=y
BR2_PACKAGE_LINUX_FIRMWARE_RADEON=y
BR2_PACKAGE_LINUX_FIRMWARE_IBT=y
BR2_PACKAGE_LINUX_FIRMWARE_RTL_87XX_BT=y
BR2_PACKAGE_LINUX_FIRMWARE_RTL_88XX_BT=y
BR2_PACKAGE_LINUX_FIRMWARE_IWLWIFI_100=y
BR2_PACKAGE_LINUX_FIRMWARE_IWLWIFI_105=y
BR2_PACKAGE_LINUX_FIRMWARE_IWLWIFI_135=y
BR2_PACKAGE_LINUX_FIRMWARE_IWLWIFI_1000=y
BR2_PACKAGE_LINUX_FIRMWARE_IWLWIFI_2000=y
BR2_PACKAGE_LINUX_FIRMWARE_IWLWIFI_2030=y
BR2_PACKAGE_LINUX_FIRMWARE_IWLWIFI_22000=y
BR2_PACKAGE_LINUX_FIRMWARE_IWLWIFI_22260=y
BR2_PACKAGE_LINUX_FIRMWARE_IWLWIFI_3160=y
BR2_PACKAGE_LINUX_FIRMWARE_IWLWIFI_3168=y
BR2_PACKAGE_LINUX_FIRMWARE_IWLWIFI_3945=y
BR2_PACKAGE_LINUX_FIRMWARE_IWLWIFI_4965=y
BR2_PACKAGE_LINUX_FIRMWARE_IWLWIFI_5000=y
BR2_PACKAGE_LINUX_FIRMWARE_IWLWIFI_6000G2A=y
BR2_PACKAGE_LINUX_FIRMWARE_IWLWIFI_6000G2B=y
BR2_PACKAGE_LINUX_FIRMWARE_IWLWIFI_7260=y
BR2_PACKAGE_LINUX_FIRMWARE_IWLWIFI_7265D=y
BR2_PACKAGE_LINUX_FIRMWARE_IWLWIFI_8000C=y
BR2_PACKAGE_LINUX_FIRMWARE_IWLWIFI_8265=y
BR2_PACKAGE_LINUX_FIRMWARE_IWLWIFI_9XXX=y
BR2_PACKAGE_LINUX_FIRMWARE_IWLWIFI_6E=y
BR2_PACKAGE_LINUX_FIRMWARE_IWLWIFI_QUZ=y
BR2_PACKAGE_LINUX_FIRMWARE_INTEL_E100=y
BR2_PACKAGE_LINUX_FIRMWARE_INTEL_ICE=y
BR2_PACKAGE_LINUX_FIRMWARE_QAT_DH895XCC=y
BR2_PACKAGE_LINUX_FIRMWARE_QAT_C3XXX=y
BR2_PACKAGE_LINUX_FIRMWARE_QAT_C62X=y
BR2_PACKAGE_LINUX_FIRMWARE_USB_SERIAL_TI=y
BR2_PACKAGE_LINUX_FIRMWARE_INTEL_ATOMISP=y
BR2_PACKAGE_ALSA_LIB=y
# BR2_PACKAGE_ALSA_LIB_OLD_SYMBOLS is not set
BR2_PACKAGE_ALSA_PLUGINS=y
BR2_PACKAGE_CA_CERTIFICATES=y
BR2_PACKAGE_OPENSSL=y
BR2_PACKAGE_LIBRESSL=y
BR2_PACKAGE_JPEG=y
BR2_PACKAGE_LIBDRM_AMDGPU=y
BR2_PACKAGE_WLROOTS_XWAYLAND=y
# BR2_PACKAGE_IFUPDOWN_SCRIPTS is not set
BR2_PACKAGE_KMOD_TOOLS=y
BR2_PACKAGE_SEATD_BUILTIN=y
BR2_PACKAGE_SEATD_DAEMON=y
BR2_TARGET_ROOTFS_SQUASHFS=y
# BR2_TARGET_ROOTFS_TAR is not set
BR2_TARGET_GRUB2=y
BR2_TARGET_GRUB2_I386_PC=y
BR2_TARGET_GRUB2_X86_64_EFI=y
BR2_TARGET_GRUB2_INSTALL_TOOLS=y
BR2_TARGET_SYSLINUX=y
BR2_PACKAGE_HOST_KMOD_GZ=y
BR2_PACKAGE_HOST_MTOOLS=y
BR2_PACKAGE_RLXOS=y
```
